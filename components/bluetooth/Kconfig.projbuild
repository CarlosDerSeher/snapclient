## components/bluetooth/Kconfig.projbuild
```kconfig
menu "Bluetooth A2DP Sink Configuration"
    depends on SOC_BT_CLASSIC_SUPPORTED
    
    config SNAPCLIENT_BT_ENABLED
        bool "Enable Bluetooth A2DP sink"
        select BT_ENABLED
        default n
        help
            Enable bluetooth. Increases ram and flash usage.

    if SNAPCLIENT_BT_ENABLED
        config SNAPCLIENT_BT_SSP_ENABLED
            bool "Enable Simple Secure Pairing"
            default n
            help
                Ignores the pin and just connects

        config SNAPCLIENT_BT_PIN
            string "snapclient bluetooth pin"
            default "0000"
            help
                Pin to connect to the bluetooth sink.

        choice SNAPCLIENT_BT_MODE
            prompt "Choose mode of operation"

            config SNAPCLIENT_BT_MODE_DISCONNECT
                bool "Stop and disconnect BT while Snapcast is playing."

            config SNAPCLIENT_BT_MODE_CONNECTED
                bool "Keep BT connected while Snapcast is playing, but stop audio."
                depends on SPIRAM

            config SNAPCLIENT_BT_MODE_STOP
                bool "Stop BT completely while Snapcast is playing."
        endchoice

        config SNAPCLIENT_PLAYER_TIMEOUT
            int "How long to wait after player stops before reset"
            default 10
            depends on SNAPCLIENT_BT_MODE_STOP
    endif



endmenu
```

## components/lightsnapcast/Kconfig.projbuild
```kconfig
menu "Lightsnapcast Player Settings"
    config PLAYER_QUEUE_EMPTY_THRESHOLD
        int "Queue empty threshold for hard resync"
        range 1 10
        default 3
        help
            Number of consecutive empty queue reads before triggering hard resync.
            Higher values tolerate brief WiFi dropouts better.
            Default: 3 (covers ~78ms of delay)

    config PLAYER_QUEUE_INSERT_TIMEOUT_MS
        int "Queue insert timeout (ms)"
        range 1 200
        default 50
        help
            Timeout for inserting audio chunks into the playback queue.
            Higher values allow queue to drain during burst arrivals.
            Default: 50ms
endmenu
```

## components/ota_server/Kconfig.projbuild
```kconfig
menu "OTA Server"
    config HTTP_AUTH_ENABLE
        bool "Require HTTP Basic Auth for OTA and web UI"
        default false
        help
            Require a valid HTTP Basic Authorization header before accepting
            a firmware upload on the OTA port or serving the DSP web UI.

    config HTTP_AUTH_USERNAME
        string "HTTP auth username"
        default "ota"
        depends on HTTP_AUTH_ENABLE
        help
            Username expected by the shared OTA/web UI HTTP Basic Auth check.

    config HTTP_AUTH_PASSWORD
        string "HTTP auth password"
        default "change-me"
        depends on HTTP_AUTH_ENABLE
        help
            Password expected by the shared OTA/web UI HTTP Basic Auth check.
            This value is stored in plain text inside sdkconfig.
endmenu
```

## components/volume_buttons/Kconfig
```kconfig
menu "Volume Buttons"

    config VOLUME_BTN_UP_GPIO
        int "GPIO for volume-up button"
        default 27
        range 0 39
        help
            GPIO pin for the volume-up button.
            Internal pull-up is enabled; wire button between pin and GND (active low).

    config VOLUME_BTN_DOWN_GPIO
        int "GPIO for volume-down button"
        default 33
        range 0 39
        help
            GPIO pin for the volume-down button.
            Same wiring as volume-up.

    config VOLUME_BTN_STREAM_ID
        string "Snapcast stream name"
        default "default"
        help
            Must match the name= parameter of the stream source in
            /etc/snapserver.conf (e.g. name=default).

    config VOLUME_BTN_STEP
        int "Volume step per press"
        default 5
        range 1 20
        help
            How much MPD volume changes per button press.

    config VOLUME_BTN_DEBOUNCE_MS
        int "Debounce time (ms)"
        default 50
        range 10 500
        help
            Minimum press duration required to register a button press.

endmenu
```

## sdkconfig.defaults.adau1961
```kconfig
#
# Snapclient Configuration
#
CONFIG_SNAPCLIENT_USE_TIMEFILTER=y
CONFIG_SNAPSERVER_USE_MDNS=y
# CONFIG_SNAPCLIENT_CONNECT_IPV6 is not set
CONFIG_SNAPCLIENT_NAME="esp-snapclient"

#
# Audio Board
#
CONFIG_AUDIO_BOARD_CUSTOM=y

#
# Custom Audio Board
#
CONFIG_DAC_ADAU1961=y

#
# DAC I2C control interface
#
CONFIG_DAC_I2C_SDA=12
CONFIG_DAC_I2C_SCL=14
CONFIG_DAC_I2C_ADDR=0x70
# end of DAC I2C control interface

#
# I2S master interface
#
CONFIG_MASTER_I2S_MCLK_PIN=3
CONFIG_MASTER_I2S_BCK_PIN=15
CONFIG_MASTER_I2S_LRCK_PIN=13
CONFIG_MASTER_I2S_DATAOUT_PIN=4
# end of I2S master interface

#
# ESP32 DSP processor config
#
# CONFIG_USE_DSP_PROCESSOR is not set
# end of ESP32 DSP processor config

#
# Snapclient Ethernet Configuration
#
CONFIG_ENV_GPIO_RANGE_MIN=0
CONFIG_ENV_GPIO_RANGE_MAX=39
CONFIG_ENV_GPIO_IN_RANGE_MAX=39
CONFIG_ENV_GPIO_OUT_RANGE_MAX=33
CONFIG_SNAPCLIENT_USE_INTERNAL_ETHERNET=y
# CONFIG_SNAPCLIENT_ETH_PHY_IP101 is not set
# CONFIG_SNAPCLIENT_ETH_PHY_RTL8201 is not set
CONFIG_SNAPCLIENT_ETH_PHY_LAN87XX=y
# CONFIG_SNAPCLIENT_ETH_PHY_DP83848 is not set
# CONFIG_SNAPCLIENT_ETH_PHY_KSZ80XX is not set
CONFIG_SNAPCLIENT_ETH_MDC_GPIO=23
CONFIG_SNAPCLIENT_ETH_MDIO_GPIO=18
CONFIG_SNAPCLIENT_ETH_PHY_RST_GPIO=17
CONFIG_SNAPCLIENT_ETH_PHY_ADDR=0
# CONFIG_SNAPCLIENT_USE_SPI_ETHERNET is not set
# end of Snapclient Ethernet Configuration
```

## sdkconfig.defaults.ai-thinker-esp32-a1s-audiokit
```kconfig
#
# Snapclient Configuration
#
CONFIG_SNAPSERVER_USE_MDNS=y
CONFIG_SNAPCLIENT_NAME="ESP32-AI-Thinker"

#
# Audio Board
#
CONFIG_ESP_AI_THINKER_ES8388_BOARD=y

#
# ESP32 DSP processor config
#
CONFIG_USE_DSP_PROCESSOR=y
```

## sdkconfig.defaults.amped-esp32s3-plus
```kconfig
#
# Snapclient Configuration
#
CONFIG_SNAPSERVER_USE_MDNS=y
CONFIG_SNAPCLIENT_NAME="amped-esp32s3-plus"

#
# Audio Board
#
CONFIG_AUDIO_BOARD_CUSTOM=y

#
# Custom Audio Board
#
CONFIG_DAC_PCM51XX=y

#
# DAC I2C control interface
#
CONFIG_DAC_I2C_SDA=18
CONFIG_DAC_I2C_SCL=8
CONFIG_DAC_I2C_ADDR=0x4D

# end of DAC I2C control interface

#
# I2S master interface
#
CONFIG_MASTER_I2S_MCLK_PIN=0
CONFIG_MASTER_I2S_BCK_PIN=14
CONFIG_MASTER_I2S_LRCK_PIN=15
CONFIG_MASTER_I2S_DATAOUT_PIN=16
# end of I2S master interface

#
# TI PCM51XX interface Configuration
#
CONFIG_PCM51XX_MUTE_PIN=17
# end of TI PCM51XX interface Configuration


#
# TI PCM51XX DSP Support
#
CONFIG_DAC_PCM51XX_EQ_SUPPORT=y

#
# ESP32 DSP processor config
#
CONFIG_USE_DSP_PROCESSOR=y
# end of ESP32 DSP processor config
```

## sdkconfig.defaults.amped-esparagus
```kconfig
#
# Snapclient Configuration
#
CONFIG_SNAPSERVER_USE_MDNS=y
CONFIG_SNAPCLIENT_NAME="amped-esparagus"

#
# Audio Board
#
CONFIG_AUDIO_BOARD_CUSTOM=y

#
# Custom Audio Board
#
CONFIG_DAC_PCM5102A=y

#
# I2S master interface
#
CONFIG_MASTER_I2S_MCLK_PIN=0
CONFIG_MASTER_I2S_BCK_PIN=26
CONFIG_MASTER_I2S_LRCK_PIN=25
CONFIG_MASTER_I2S_DATAOUT_PIN=22

#
# TI PCM5102A interface Configuration
#
CONFIG_PCM5102A_MUTE_PIN=13
# end of TI PCM5102A interface Configuration

#
# ESP32 DSP processor config
#
CONFIG_USE_DSP_PROCESSOR=y
CONFIG_SNAPCLIENT_USE_SOFT_VOL=y
```

## sdkconfig.defaults.audio-brick-esp32s3
```kconfig
#
# Snapclient Configuration
#
CONFIG_SNAPSERVER_USE_MDNS=y
# CONFIG_SNAPCLIENT_CONNECT_IPV6 is not set
CONFIG_SNAPCLIENT_NAME="esparagus-audio-brick"

#
# Audio Board
#
CONFIG_AUDIO_BOARD_CUSTOM=y

#
# Custom Audio Board
#
CONFIG_DAC_TAS5805M=y

#
# DAC I2C control interface
#
CONFIG_DAC_I2C_SDA=8
CONFIG_DAC_I2C_SCL=9
CONFIG_DAC_I2C_ADDR=0x4c
# end of DAC I2C control interface

#
# I2S master interface
#
CONFIG_MASTER_I2S_MCLK_PIN=0
CONFIG_MASTER_I2S_BCK_PIN=14
CONFIG_MASTER_I2S_LRCK_PIN=15
CONFIG_MASTER_I2S_DATAOUT_PIN=16
# end of I2S master interface

#
# TAS5805M interface Configuration
#
CONFIG_PIN_DAC_PWDN=17
# end of TAS5805M interface Configuration

#
# TAS5805M DSP Support
#
CONFIG_DAC_TAS5805M_EQ_SUPPORT=y
# end of TAS5805M DSP Support

#
# ESP32 DSP processor config
#
CONFIG_USE_DSP_PROCESSOR=y
```

## sdkconfig.defaults.espressif-lyra-t-42
```kconfig
#
# Snapclient Configuration
#
CONFIG_SNAPSERVER_USE_MDNS=y
CONFIG_SNAPCLIENT_NAME="ESP32-LyraT"

#
# Audio Board
#
CONFIG_ESP_LYRAT_V4_2_BOARD=y

#
# ESP32 DSP processor config
#
CONFIG_USE_DSP_PROCESSOR=y
```

## sdkconfig.defaults.espressif-lyra-t-43
```kconfig
#
# Snapclient Configuration
#
CONFIG_SNAPSERVER_USE_MDNS=y
CONFIG_SNAPCLIENT_NAME="ESP32-LyraT"

#
# Audio Board
#
CONFIG_ESP_LYRAT_V4_3_BOARD=y

#
# ESP32 DSP processor config
#
CONFIG_USE_DSP_PROCESSOR=y


#
# IRAM optimizations
#
CONFIG_ESP_WIFI_EXTRA_IRAM_OPT=n
CONFIG_LWIP_IRAM_OPTIMIZATION=n
```

## sdkconfig.defaults.espressif-lyra-t-mini
```kconfig
#
# Snapclient Configuration
#
CONFIG_SNAPSERVER_USE_MDNS=y
CONFIG_SNAPCLIENT_NAME="ESP32-LyraT-Mini"

#
# Audio Board
#
CONFIG_ESP_LYRAT_MINI_V1_1_BOARD=y

#
# ESP32 DSP processor config
#
CONFIG_USE_DSP_PROCESSOR=y
```

## sdkconfig.defaults.hifi-esparagus
```kconfig
#
# Snapclient Configuration
#
CONFIG_SNAPSERVER_USE_MDNS=y
CONFIG_SNAPCLIENT_NAME="hifi-esparagus"

#
# Audio Board
#
CONFIG_AUDIO_BOARD_CUSTOM=y

#
# Custom Audio Board
#
CONFIG_DAC_PCM5102A=y

#
# I2S master interface
#
CONFIG_MASTER_I2S_MCLK_PIN=0
CONFIG_MASTER_I2S_BCK_PIN=26
CONFIG_MASTER_I2S_LRCK_PIN=25
CONFIG_MASTER_I2S_DATAOUT_PIN=22

#
# ESP32 DSP processor config
#
CONFIG_USE_DSP_PROCESSOR=y
CONFIG_SNAPCLIENT_USE_SOFT_VOL=y
```

## sdkconfig.defaults.loud-esp32s3
```kconfig
#
# Snapclient Configuration
#
CONFIG_SNAPSERVER_USE_MDNS=y
CONFIG_SNAPCLIENT_NAME="loud-esp32-s3"

#
# Audio Board
#
CONFIG_AUDIO_BOARD_CUSTOM=y

#
# Custom Audio Board
#
CONFIG_DAC_MAX98357=y

#
# I2S master interface
#
CONFIG_MASTER_I2S_MCLK_PIN=0
CONFIG_MASTER_I2S_BCK_PIN=14
CONFIG_MASTER_I2S_LRCK_PIN=15
CONFIG_MASTER_I2S_DATAOUT_PIN=16

#
# MAX98357 interface Configuration
#
CONFIG_MAX98357_MUTE_PIN=17
# end of MAX98357 interface Configuration

#
# ESP32 DSP processor config
#
CONFIG_USE_DSP_PROCESSOR=y
CONFIG_SNAPCLIENT_USE_SOFT_VOL=y
```

## sdkconfig.defaults.loud-esp32s3-plus
```kconfig
#
# Snapclient Configuration
#
CONFIG_SNAPSERVER_USE_MDNS=y
CONFIG_SNAPCLIENT_NAME="loud-esp32s3-plus"

#
# Audio Board
#
CONFIG_AUDIO_BOARD_CUSTOM=y

#
# Custom Audio Board
#
#
CONFIG_DAC_MA120X0=y

#
# DAC I2C control interface
#
CONFIG_DAC_I2C_SDA=8
CONFIG_DAC_I2C_SCL=9
CONFIG_DAC_I2C_ADDR=0x20
# end of DAC I2C control interface

#
# I2S master interface
#
CONFIG_MASTER_I2S_MCLK_PIN=-1
CONFIG_MASTER_I2S_BCK_PIN=14
CONFIG_MASTER_I2S_LRCK_PIN=15
CONFIG_MASTER_I2S_DATAOUT_PIN=16
# end of I2S master interface

#
# Merus MA120x0 interface Configuration
#
CONFIG_MA120X0_NENABLE_PIN=17
CONFIG_MA120X0_NENABLE_INVERT=y
CONFIG_MA120X0_NMUTE_PIN=18
CONFIG_MA120X0_NERR_PIN=-1
CONFIG_MA120X0_NCLIP_PIN=-1
CONFIG_MA120X0_VOL_MAX_DB=0
CONFIG_MA120X0_VOL_MIN_DB=-60

# end of Merus MA120x0 interface Configuration

#
# ESP32 DSP processor config
#
#CONFIG_USE_DSP_PROCESSOR=y

#
# Log Level
#
# CONFIG_LOG_DEFAULT_LEVEL_NONE is not set
# CONFIG_LOG_DEFAULT_LEVEL_ERROR is not set
# CONFIG_LOG_DEFAULT_LEVEL_WARN is not set
# CONFIG_LOG_DEFAULT_LEVEL_INFO=y
CONFIG_LOG_DEFAULT_LEVEL_DEBUG=y
# CONFIG_LOG_DEFAULT_LEVEL_VERBOSE is not set
CONFIG_LOG_DEFAULT_LEVEL=4
CONFIG_LOG_MAXIMUM_EQUALS_DEFAULT=y
# CONFIG_LOG_MAXIMUM_LEVEL_DEBUG is not set
# CONFIG_LOG_MAXIMUM_LEVEL_VERBOSE is not set
CONFIG_LOG_MAXIMUM_LEVEL=4
```

## sdkconfig.defaults.louder-esp32-plus
```kconfig
#
# Snapclient Configuration
#
CONFIG_SNAPSERVER_USE_MDNS=y
CONFIG_SNAPCLIENT_NAME="louder-esp32-plus"

#
# Audio Board
#
CONFIG_AUDIO_BOARD_CUSTOM=y

#
# Custom Audio Board
#
CONFIG_DAC_TAS5805M=y

#
# DAC I2C control interface
#
CONFIG_DAC_I2C_SDA=21
CONFIG_DAC_I2C_SCL=27
CONFIG_DAC_I2C_ADDR=0x4C

#
# I2S master interface
#
CONFIG_MASTER_I2S_MCLK_PIN=0
CONFIG_MASTER_I2S_BCK_PIN=26
CONFIG_MASTER_I2S_LRCK_PIN=25
CONFIG_MASTER_I2S_DATAOUT_PIN=22
# end of I2S master interface

#
# TAS5805M interface configuration
#
CONFIG_PIN_DAC_PWDN=33
# end of TAS5805M interface configuration

#
# TAS5805M DSP Support
#
CONFIG_DAC_TAS5805M_EQ_SUPPORT=y
# end of TAS5805M DSP Support

#
# ESP32 DSP processor config
#
CONFIG_USE_DSP_PROCESSOR=y
```

## sdkconfig.defaults.max98357a-esp32-s2
```kconfig
#
# Snapclient Configuration
#
CONFIG_SNAPSERVER_USE_MDNS=y
CONFIG_SNAPCLIENT_NAME="esp-snapclient"

#
# Audio Board
#
CONFIG_AUDIO_BOARD_CUSTOM=y

#
# Custom Audio Board
#
CONFIG_DAC_MAX98357=y

#
# I2S master interface
#
CONFIG_MASTER_I2S_MCLK_PIN=-1
CONFIG_MASTER_I2S_BCK_PIN=10
CONFIG_MASTER_I2S_LRCK_PIN=11
CONFIG_MASTER_I2S_DATAOUT_PIN=12
# end of I2S master interface

#
# MAX98357 interface Configuration
#
CONFIG_MAX98357_MUTE_PIN=13
# end of MAX98357 interface Configuration

#
# ESP32 DSP processor config
#
CONFIG_USE_DSP_PROCESSOR=y
CONFIG_SNAPCLIENT_USE_SOFT_VOL=y
# end of ESP32 DSP processor config

#
# Snapclient Ethernet Configuration
#
CONFIG_ENV_GPIO_RANGE_MIN=0
CONFIG_ENV_GPIO_RANGE_MAX=46
CONFIG_ENV_GPIO_IN_RANGE_MAX=46
CONFIG_ENV_GPIO_OUT_RANGE_MAX=45
# CONFIG_SNAPCLIENT_USE_SPI_ETHERNET is not set
# end of Snapclient Ethernet Configuration
```

## sdkconfig.defaults.pcm5102a
```kconfig
#
# Snapclient Configuration
#
CONFIG_SNAPSERVER_USE_MDNS=y
# CONFIG_SNAPCLIENT_CONNECT_IPV6 is not set
CONFIG_SNAPCLIENT_NAME="Arbeitszimmer"

#
# Audio Board
#
CONFIG_AUDIO_BOARD_CUSTOM=y

#
# Custom Audio Board
#
CONFIG_DAC_PCM5102A=y

#
# I2S master interface
#
CONFIG_MASTER_I2S_MCLK_PIN=0
CONFIG_MASTER_I2S_BCK_PIN=26
CONFIG_MASTER_I2S_LRCK_PIN=25
CONFIG_MASTER_I2S_DATAOUT_PIN=22
# end of I2S master interface

#
# TI PCM5102A interface Configuration
#
CONFIG_PCM5102A_MUTE_PIN=33
# end of TI PCM5102A interface Configuration

#
# ESP32 DSP processor config
#
CONFIG_USE_DSP_PROCESSOR=y
CONFIG_SNAPCLIENT_USE_SOFT_VOL=y
# end of ESP32 DSP processor config
```

## sdkconfig.defaults.pcm5102a-wt32-eth01
```kconfig
#
# Snapclient Configuration
#
CONFIG_SNAPSERVER_USE_MDNS=y
# CONFIG_SNAPSERVER_HOST is not set
# CONFIG_SNAPSERVER_PORT is not set
CONFIG_SNAPCLIENT_NAME="WT32-ETH01"

#
# Audio Board
#
CONFIG_AUDIO_BOARD_CUSTOM=y

#
# Custom Audio Board
#
CONFIG_DAC_PCM5102A=y

#
# I2S master interface
#
CONFIG_MASTER_I2S_MCLK_PIN=-1
CONFIG_MASTER_I2S_BCK_PIN=15
CONFIG_MASTER_I2S_LRCK_PIN=4
CONFIG_MASTER_I2S_DATAOUT_PIN=14
# end of I2S master interface

#
# TI PCM5102A interface Configuration
#
CONFIG_PCM5102A_MUTE_PIN=5
# end of TI PCM5102A interface Configuration

#
# ESP32 DSP processor config
#
CONFIG_USE_DSP_PROCESSOR=y
CONFIG_SNAPCLIENT_USE_SOFT_VOL=y
# end of ESP32 DSP processor config

#
# Snapclient Ethernet Configuration
#
CONFIG_ENV_GPIO_RANGE_MIN=0
CONFIG_ENV_GPIO_RANGE_MAX=39
CONFIG_ENV_GPIO_IN_RANGE_MAX=39
CONFIG_ENV_GPIO_OUT_RANGE_MAX=33
CONFIG_SNAPCLIENT_USE_INTERNAL_ETHERNET=y
# CONFIG_SNAPCLIENT_ETH_PHY_IP101 is not set
# CONFIG_SNAPCLIENT_ETH_PHY_RTL8201 is not set
CONFIG_SNAPCLIENT_ETH_PHY_LAN87XX=y
# CONFIG_SNAPCLIENT_ETH_PHY_DP83848 is not set
# CONFIG_SNAPCLIENT_ETH_PHY_KSZ80XX is not set
CONFIG_SNAPCLIENT_ETH_MDC_GPIO=23
CONFIG_SNAPCLIENT_ETH_MDIO_GPIO=18
CONFIG_SNAPCLIENT_ETH_PHY_RST_GPIO=16
CONFIG_SNAPCLIENT_ETH_PHY_ADDR=1
# CONFIG_SNAPCLIENT_USE_SPI_ETHERNET is not set
# end of Snapclient Ethernet Configuration
```
