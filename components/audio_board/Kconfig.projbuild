## components/dsp_processor/Kconfig.projbuild
```kconfig
# Config file for ESP32 DSP Processor

menu "ESP32 DSP processor config"
    config USE_DSP_PROCESSOR
        bool "enable signal processing on audio data"
        default false
        help
            enable audio filtering before queueing it to player component

    config SNAPCLIENT_MIX_LR_TO_MONO
        bool "mix stereo audio to mono"
        default false
        depends on USE_DSP_PROCESSOR
        help
            mix stereo audio (left and right channel) to mono and play it on the left AND the right channel

    config SNAPCLIENT_USE_SOFT_VOL
        bool "Use software volume"
        default false
        depends on USE_DSP_PROCESSOR
        help
            Use software volume mixer instead of hardware mixer (when your DAC does not support hardware volume control).

    config SNAPCLIENT_VOLUME_CURVE_DB_RANGE
        int "Volume curve range in dB (0=linear, 60=standard, 90=max)"
        default 60
        depends on USE_DSP_PROCESSOR
        range 0 90
        help
            Controls the shape of the software volume curve.
            0 = linear passthrough (y = x, no shaping).
            >0 = exponential curve y = a * exp(b * x) where
            a = 10^(-dB/20), mapping slider [0,1] to amplitude
            [10^(-dB/20), 1.0] for perceptually linear loudness.
            60 dB is standard for consumer audio.

    config USE_DSP_SOFT_CLIP
        bool "Use cubic soft clipping"
        default false
        depends on USE_DSP_PROCESSOR
        help
            Apply cubic soft clipping to prevent hard clipping distortion when signal exceeds the ±1.0 range.
            This provides a smoother transition when the signal approaches clipping, reducing harsh distortion.

endmenu
```

## main/Kconfig.projbuild
```kconfig
menu "Snapclient Configuration"
    config SNAPSERVER_USE_MDNS
        bool "Use mDNS"
        default y
        help
            Use mDNS to look for the snapserver to connect to on the local network.

    config SNAPCLIENT_CONNECT_IPV6
        bool "use IPv6"
        default n
        help
            Use IPv6 to connect to snapserver

    config SNAPSERVER_HOST
        string "Snapserver host"
        default "192.168.1.158"
        depends on !SNAPSERVER_USE_MDNS
        help
            Host (ip or name) of snapserver to connect to if mDNS is disabled or the mDNS resolution fails.

    config SNAPSERVER_PORT
        int "Snapserver port"
        default 1704
        depends on !SNAPSERVER_USE_MDNS
        help
            Port of the snapserver to connect to.

    config SNAPCLIENT_NAME
        string "snapclient name"
        default "ESP32-Caster"
        help
            Name of the client to register the snapserver.

	menu "HTTP Server Setting"
		config WEB_PORT
			int "User interface HTTP Server Port"
			default 8000
			help
				HTTP server port to use.
	endmenu

	config USE_SAMPLE_INSERTION
        bool "Use sample insertion"
        default y
        help
            There are two syncronization implementations.

            1. APLL tuning (ONLY use with DACs having MCLK input)
            2. sample insertion (duplicates a sample now and then to keep up sync)

            Both approaches have similar performance keeping clients in sync <= 500µs

endmenu
```
