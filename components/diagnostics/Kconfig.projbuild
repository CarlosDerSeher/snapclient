## components/diagnostics/Kconfig.projbuild
```kconfig
menu "Snapclient Diagnostics"

    config SNAPCLIENT_HEAP_DIAG
        bool "Runtime heap and stack diagnostics"
        default n
        select FREERTOS_USE_TRACE_FACILITY
        help
            Log free / largest free block / minimum free heap (8-bit and IRAM) and the
            stack high-water mark of every task at boot, got IP, 10 s and 10 min after
            playback started, and periodically. Uses a static 3 KB task stack.

    config SNAPCLIENT_HEAP_DIAG_INTERVAL_S
        int "Heap diagnostics periodic interval (s)"
        default 60
        range 5 3600
        depends on SNAPCLIENT_HEAP_DIAG

    config SNAPCLIENT_HEAP_DIAG_PLAY_LONG_S
        int "Heap diagnostics long-playback snapshot (s)"
        default 600
        range 20 86400
        depends on SNAPCLIENT_HEAP_DIAG
        help
            Seconds after playback start for the "long playback" snapshot. 600 (10 min)
            for acceptance runs, shorter for quick comparisons.

    config SNAPCLIENT_SYNC_DIAG
        bool "Sync diagnostics"
        default n
        help
            Log a summary (tag SYNCDIAG) of message lag from server to client,
            time sync round trips and replies, pcm queue, decoder waits,
            resyncs and Wi-Fi disconnects every few seconds, and every
            server settings message with its lag. Uses a static 3 KB task
            stack.

    config SNAPCLIENT_SYNC_DIAG_INTERVAL_S
        int "Sync diagnostics interval (s)"
        default 10
        range 1 3600
        depends on SNAPCLIENT_SYNC_DIAG

    comment "See components/diagnostics/README.md for the log lines"

endmenu
```

## components/dsp_processor/Kconfig.projbuild
```kconfig
# Config file for ESP32 DSP Processor

menu "ESP32 DSP processor config"
    config USE_DSP_PROCESSOR
        bool "enable signal processing on audio data"
        default false
        help
            enable audio filtering before queueing it to player component

    config SNAPCLIENT_MIX_LR_TO_MONO
        bool "mix stereo audio to mono"
        default false
        depends on USE_DSP_PROCESSOR
        help
            mix stereo audio (left and right channel) to mono and play it on the left AND the right channel

    config SNAPCLIENT_USE_SOFT_VOL
        bool "Use software volume"
        default false
        depends on USE_DSP_PROCESSOR
        help
            Use software volume mixer instead of hardware mixer (when your DAC does not support hardware volume control).

    config SNAPCLIENT_VOLUME_CURVE_DB_RANGE
        int "Volume curve range in dB (0=linear, 90=max)"
        default 0
        depends on SNAPCLIENT_USE_SOFT_VOL
        range 0 90
        help
            Controls the shape of the software volume curve.
            0 = linear passthrough (y = x, no shaping).
            >0 = exponential curve y = 10^(dB * (x - 1) / 20), mapping
            slider [0,1] to amplitude [10^(-dB/20), 1.0] for perceptually
            linear loudness. 40-60 dB is a good range to try; it can also be
            changed at runtime on the DSP settings page.

    config USE_DSP_SOFT_CLIP
        bool "Use cubic soft clipping"
        default false
        depends on USE_DSP_PROCESSOR
        help
            Apply cubic soft clipping to prevent hard clipping distortion when signal exceeds the ±1.0 range.
            This provides a smoother transition when the signal approaches clipping, reducing harsh distortion.

    menu "Bass Treble EQ defaults"
        depends on USE_DSP_PROCESSOR

        config SNAPCLIENT_DSP_EQ_BASS_FREQ_HZ
            int "Bass frequency (Hz)"
            range 30 500
            default 150
            help
                Default frequency of the low shelf filter in the bass/treble EQ
                flow. Used until a value is stored through the web UI.

        config SNAPCLIENT_DSP_EQ_BASS_GAIN_DB
            int "Bass gain (dB)"
            range -15 15
            default 0
            help
                Default gain of the low shelf filter in the bass/treble EQ flow.
                Used until a value is stored through the web UI.

        config SNAPCLIENT_DSP_EQ_TREBLE_FREQ_HZ
            int "Treble frequency (Hz)"
            range 2000 16000
            default 8000
            help
                Default frequency of the high shelf filter in the bass/treble EQ
                flow. Used until a value is stored through the web UI.

        config SNAPCLIENT_DSP_EQ_TREBLE_GAIN_DB
            int "Treble gain (dB)"
            range -15 15
            default 0
            help
                Default gain of the high shelf filter in the bass/treble EQ flow.
                Used until a value is stored through the web UI.
    endmenu

endmenu
```

## main/Kconfig.projbuild
```kconfig
menu "Snapclient Configuration"
    config SNAPCLIENT_USE_TIMEFILTER
        bool "Use Kalman Timefilter"
        default y
        help
            Use Kalman Timefilter for latency to server estimation. The non default is a median filter.
            
    config SNAPSERVER_USE_MDNS
        bool "Use mDNS"
        default y
        help
            Use mDNS to look for the snapserver to connect to on the local network.

    config SNAPCLIENT_CONNECT_IPV6
        bool "use IPv6"
        default n
        help
            Use IPv6 to connect to snapserver

    config SNAPSERVER_HOST
        string "Snapserver host"
        default "192.168.1.158"
        depends on !SNAPSERVER_USE_MDNS
        help
            Host (ip or name) of snapserver to connect to if mDNS is disabled or the mDNS resolution fails.

    config SNAPSERVER_PORT
        int "Snapserver port"
        default 1704
        depends on !SNAPSERVER_USE_MDNS
        help
            Port of the snapserver to connect to.

    config SNAPCLIENT_NAME
        string "snapclient name"
        default "ESP32-Caster"
        help
            Name of the client to register the snapserver.

    config SNAPCLIENT_DISABLE_OPUS
        bool "Disable Opus support"
        default n
        help
            Build without the Opus decoder. The snapserver must then use the flac or pcm codec;
            an Opus stream is rejected with an error in the log.

            The Opus decoder keeps large arrays on the stack, so without it the snapcast client
            task stack shrinks from 13 KB to 4 KB, and the firmware is ~90 KB smaller.
            Recommended for boards without PSRAM, where every KB of RAM is audio buffer space.

	menu "HTTP Server Setting"
		config SNAPCLIENT_ENABLE_WEB_UI
			bool "Enable local web UI"
			default y
			help
				Start the local HTTP interface for device settings. When DSP is
				enabled, the UI also exposes DSP flow and filter configuration.

		config SNAPCLIENT_WEB_UI_STATUS
			bool "Show runtime status in the web UI"
			depends on SNAPCLIENT_ENABLE_WEB_UI
			default y if SPIRAM
			default n
			help
				Add a live status section (network, snapserver connection, heap)
				to the General Settings page. Each status request builds a JSON
				response on the heap, and the page polls it every 5 s, so this
				is enabled by default only on boards with PSRAM.

		config WEB_PORT
			int "User interface HTTP Server Port"
			default 80
			help
				HTTP server port to use.

		config HTTP_AUTH_ENABLE
			bool "Require HTTP Basic Auth for OTA and web UI"
			default n
			help
				Require a valid HTTP Basic Authorization header before accepting
				a firmware upload or serving the web UI.

		config HTTP_AUTH_USERNAME
			string "HTTP auth username"
			default "ota"
			depends on HTTP_AUTH_ENABLE
			help
				Username for the OTA and web UI HTTP Basic Auth check.

		config HTTP_AUTH_PASSWORD
			string "HTTP auth password"
			default "change-me"
			depends on HTTP_AUTH_ENABLE
			help
				Password for the OTA and web UI HTTP Basic Auth check.
				This value is stored in plain text inside sdkconfig.

		config SNAPCLIENT_WEB_OTA
			bool "Enable OTA firmware upload via web interface"
			depends on SNAPCLIENT_ENABLE_WEB_UI
			default y
			help
				Expose a /api/ota/upload endpoint and an OTA Update tab in the web UI.
				This is the only way to update over the air: without it (or without
				the web UI) the firmware can only be flashed over serial.
	endmenu

	config USE_SAMPLE_INSERTION
        bool "Use sample insertion"
        default y
        help
            There are two syncronization implementations.

            1. APLL tuning (ONLY use with DACs having MCLK input)
            2. sample insertion (duplicates a sample now and then to keep up sync)

            Both approaches have similar performance keeping clients in sync <= 500µs

endmenu
```

## sdkconfig.defaults.raspiaudio-muse-luxe
```kconfig
#
# Snapclient Configuration
#
CONFIG_SNAPSERVER_USE_MDNS=y
CONFIG_SNAPCLIENT_NAME="ESP32-Muse-Luxe"

#
# Audio Board
#
CONFIG_ESP_MUSE_LUXE_BOARD=y

#
# ESP32 DSP processor config
#
CONFIG_USE_DSP_PROCESSOR=y


#
# IRAM optimizations
#
CONFIG_ESP_WIFI_EXTRA_IRAM_OPT=n
CONFIG_LWIP_IRAM_OPTIMIZATION=n
```
